## tools/batman/esp32/sdkconfig.defaults
```kconfig
CONFIG_FREERTOS_HZ=1000
CONFIG_BT_ENABLED=y
CONFIG_ESP_TLS_PSK_VERIFICATION=y
;CONFIG_LWIP_STATS=y

;CONFIG_FREERTOS_UNICORE=n
;CONFIG_LWIP_IRAM_OPTIMIZATION=y
;CONFIG_LWIP_TCPIP_TASK_PRIO=23
;CONFIG_ESP32S3_DEFAULT_CPU_FREQ_240=y
;CONFIG_ESP32S3_DEFAULT_CPU_FREQ_MHZ=240
;CONFIG_COMPILER_OPTIMIZATION_PERF=y

CONFIG_ESPTOOLPY_FLASHSIZE_8MB=y
CONFIG_ESPTOOLPY_FLASHSIZE="8MB"

;CONFIG_PARTITION_TABLE_SINGLE_APP_LARGE=y
;CONFIG_PARTITION_TABLE_FILENAME="partitions_singleapp_large.csv"

;CONFIG_PARTITION_TABLE_CUSTOM=y
;CONFIG_PARTITION_TABLE_CUSTOM_FILENAME="default_8MB.csv"

;from iperf
CONFIG_ESP32_WIFI_STATIC_RX_BUFFER_NUM=16
CONFIG_ESP32_WIFI_DYNAMIC_RX_BUFFER_NUM=64
CONFIG_ESP32_WIFI_DYNAMIC_TX_BUFFER_NUM=64
CONFIG_ESP32_WIFI_AMPDU_TX_ENABLED=y
CONFIG_ESP32_WIFI_TX_BA_WIN=32
CONFIG_ESP32_WIFI_AMPDU_RX_ENABLED=y
CONFIG_ESP32_WIFI_RX_BA_WIN=32

CONFIG_LWIP_TCP_SND_BUF_DEFAULT=65535
CONFIG_LWIP_TCP_WND_DEFAULT=65535
CONFIG_LWIP_TCP_RECVMBOX_SIZE=64
CONFIG_LWIP_UDP_RECVMBOX_SIZE=64
CONFIG_LWIP_TCPIP_RECVMBOX_SIZE=64
```
